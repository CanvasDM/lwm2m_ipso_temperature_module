## Kconfig
```kconfig
#
# Copyright (c) 2022 Laird Connectivity LLC
#
# SPDX-License-Identifier: LicenseRef-LairdConnectivity-Clause
#
menuconfig LCZ_LWM2M_TEMPERATURE
	bool "Enable LwM2M Temperature Object"
	depends on LCZ_LWM2M_UTIL
	depends on LCZ_LWM2M_IPSO_TEMP_SENSOR

if LCZ_LWM2M_TEMPERATURE

module=LCZ_LWM2M_TEMPERATURE
module-str=LWM2M_TEMPERATURE
source "subsys/logging/Kconfig.template.log_config"

endif # LCZ_LWM2M_TEMPERATURE
```
